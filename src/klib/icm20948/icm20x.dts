/dts-v1/;
/plugin/;
/ {
	compatible = "brcm,bcm2712";
	fragment@0 {
		target = <&i2c0>;
		__overlay__ {
			#address-cells = <1>;
			#size-cells = <0>;

			icm_accel@69 {
				compatible = "invensense,icm20x";

				reg = <0x69>;
				status = "okay";
			};
		};
	};

};